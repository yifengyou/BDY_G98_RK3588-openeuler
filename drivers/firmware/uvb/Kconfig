## drivers/firmware/uvb/Kconfig
```kconfig
config UDFI
	bool "UDFI Drivers"
	depends on ARM64
	default n
	help
	  UBIOS Distributed Firmware Interface (UDFI) support for kernel
	  requires a UBIOS platform. UDFI provides communication channels
	  among OS, BIOS and other firmware:
	  (1) Call ID Service (CIS), by which OS sends a call to BIOS, can be used
	  to operate specific hardware, read/write BIOS information or call BIOS
	  functions , e.g., read/write RTC, modify boot options, etc.
	  (2) Notify ID Information (NII), by which OS receives notification from
	  BIOS, provides notification mechanism from BIOS to OS. This is useful
	  when events detected and BIOS needs to inform OS, e.g., RAS events.

if UDFI

config UDFI_CIS
	tristate "CIS framework"
	select UDFI_ODF
	default n
	help
	  This option is selected if CIS framework is needed.

config UDFI_ODF
	tristate "odf parse"
	default n
	help
	  This driver support UBIOS object description specification parse

endif # UDFI
```

## drivers/staging/xcall/Kconfig
```kconfig
# SPDX-License-Identifier: GPL-2.0
menu "Xcall"

if ARM64

config DYNAMIC_XCALL_TESTCASE
	tristate "xcall2.0 test case"
	depends on DYNAMIC_XCALL
	help
	  A simple example of using the xcall2.0 kernel module.
	  This module can be combined with the syscall sub-item of
	  Unixbench to evaluate the baseline noise of xcall2.0's
	  "Dynamic Instruction Replacement" mechanism. Users can
	  also use this module as a reference to implement custom
	  system calls.

endif # if ARM64

endmenu
```

## fs/mfs/Kconfig
```kconfig
# SPDX-License-Identifier: GPL-2.0-only

config MFS_FS
	tristate "MFS filesystem support"
	help
	  MFS provides a cache-programmable ability for users.
	  It is a stackable file system, and will post miss events
	  during reading data which is not in cache (memory or disk).
	  Based on these events, users can trigger the target io for each
	  application.

	  If unsure, say N.
```
